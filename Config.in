## configs/demo_s6_musl_static_qemu_mips32r2el_malta_defconfig
```kconfig
BR2_mipsel=y
BR2_mips_32r2=y
BR2_STATIC_LIBS=y
BR2_TOOLCHAIN_BUILDROOT_MUSL=y
BR2_PACKAGE_HOST_LINUX_HEADERS_CUSTOM_4_9=y
BR2_INIT_NONE=y
BR2_TARGET_GENERIC_GETTY_PORT="ttyS0"
BR2_SYSTEM_DHCP="eth0"
BR2_LINUX_KERNEL=y
BR2_LINUX_KERNEL_CUSTOM_VERSION=y
BR2_LINUX_KERNEL_CUSTOM_VERSION_VALUE="4.9.6"
BR2_LINUX_KERNEL_USE_CUSTOM_CONFIG=y
BR2_LINUX_KERNEL_CUSTOM_CONFIG_FILE="board/qemu/mips32r2el-malta/linux-4.9.config"
BR2_LINUX_KERNEL_VMLINUX=y
BR2_TARGET_ROOTFS_EXT2=y
# BR2_TARGET_ROOTFS_TAR is not set
BR2_INIT_S6_INIT=y
BR2_PACKAGE_S6_BR2_INIT_SERVICES=y
```

## configs/demo_s6_musl_static_qemu_ppc_g3beige_defconfig
```kconfig
BR2_powerpc=y
BR2_powerpc_750=y
BR2_STATIC_LIBS=y
BR2_TOOLCHAIN_BUILDROOT_MUSL=y
BR2_PACKAGE_HOST_LINUX_HEADERS_CUSTOM_4_9=y
BR2_INIT_NONE=y
BR2_TARGET_GENERIC_GETTY_PORT="ttyS0"
BR2_SYSTEM_DHCP="eth0"
BR2_LINUX_KERNEL=y
BR2_LINUX_KERNEL_CUSTOM_VERSION=y
BR2_LINUX_KERNEL_CUSTOM_VERSION_VALUE="4.9.6"
BR2_LINUX_KERNEL_USE_CUSTOM_CONFIG=y
BR2_LINUX_KERNEL_CUSTOM_CONFIG_FILE="board/qemu/ppc-g3beige/linux-4.9.config"
BR2_LINUX_KERNEL_VMLINUX=y
BR2_TARGET_ROOTFS_EXT2=y
# BR2_TARGET_ROOTFS_TAR is not set
BR2_INIT_S6_INIT=y
BR2_PACKAGE_S6_BR2_INIT_SERVICES=y
```

## configs/demo_s6_rpi_defconfig
```kconfig
BR2_arm=y
BR2_arm1176jzf_s=y
BR2_STATIC_LIBS=y
BR2_TOOLCHAIN_BUILDROOT_MUSL=y
BR2_PACKAGE_HOST_LINUX_HEADERS_CUSTOM_4_4=y
BR2_TOOLCHAIN_BUILDROOT_CXX=y
BR2_TARGET_GENERIC_ISSUE="Welcome to S6 demo"
BR2_INIT_NONE=y
BR2_ROOTFS_DEVICE_TABLE="system/device_table.txt $(BR2_EXTERNAL)/board/common/device_table.txt"
BR2_TARGET_GENERIC_ROOT_PASSWD="root"
BR2_TARGET_GENERIC_GETTY_PORT="tty1"
BR2_SYSTEM_DHCP="eth0"
BR2_ROOTFS_OVERLAY="$(BR2_EXTERNAL)/board/common/overlay $(BR2_EXTERNAL)/board/rpi/overlay"
BR2_ROOTFS_POST_BUILD_SCRIPT="board/raspberrypi/post-build.sh"
BR2_ROOTFS_POST_IMAGE_SCRIPT="board/raspberrypi/post-image.sh"
BR2_LINUX_KERNEL=y
BR2_LINUX_KERNEL_CUSTOM_GIT=y
BR2_LINUX_KERNEL_CUSTOM_REPO_URL="https://github.com/raspberrypi/linux.git"
BR2_LINUX_KERNEL_CUSTOM_REPO_VERSION="c6d86f7aa554854b04614ebb4d394766081fb41f"
BR2_LINUX_KERNEL_DEFCONFIG="bcmrpi"
BR2_LINUX_KERNEL_DTS_SUPPORT=y
BR2_LINUX_KERNEL_INTREE_DTS_NAME="bcm2708-rpi-b bcm2708-rpi-b-plus bcm2708-rpi-cm"
BR2_PACKAGE_BUSYBOX_CONFIG="$(BR2_EXTERNAL)/board/common/busybox.config"
BR2_PACKAGE_RPI_FIRMWARE=y
# BR2_PACKAGE_RPI_FIRMWARE_INSTALL_DTB_OVERLAYS is not set
BR2_PACKAGE_DROPBEAR=y
BR2_PACKAGE_NTP=y
BR2_TARGET_ROOTFS_EXT2=y
BR2_TARGET_ROOTFS_EXT2_4=y
# BR2_TARGET_ROOTFS_TAR is not set
BR2_PACKAGE_HOST_DOSFSTOOLS=y
BR2_PACKAGE_HOST_GENIMAGE=y
BR2_PACKAGE_HOST_MTOOLS=y
BR2_INIT_S6_INIT=y
BR2_PACKAGE_S6_BR2_INIT_SERVICES=y
BR2_PACKAGE_S6_LINUX_INIT=y
```

## configs/demo_s6_uclibc_static_qemu_arm_versatile_defconfig
```kconfig
BR2_arm=y
BR2_STATIC_LIBS=y
BR2_PACKAGE_HOST_LINUX_HEADERS_CUSTOM_4_9=y
BR2_INIT_NONE=y
BR2_TARGET_GENERIC_GETTY_PORT="ttyAMA0"
BR2_SYSTEM_DHCP="eth0"
BR2_LINUX_KERNEL=y
BR2_LINUX_KERNEL_CUSTOM_VERSION=y
BR2_LINUX_KERNEL_CUSTOM_VERSION_VALUE="4.9.6"
BR2_LINUX_KERNEL_USE_CUSTOM_CONFIG=y
BR2_LINUX_KERNEL_CUSTOM_CONFIG_FILE="board/qemu/arm-versatile/linux-4.9.config"
BR2_LINUX_KERNEL_DTS_SUPPORT=y
BR2_LINUX_KERNEL_INTREE_DTS_NAME="versatile-pb"
BR2_TARGET_ROOTFS_EXT2=y
# BR2_TARGET_ROOTFS_TAR is not set
BR2_INIT_S6_INIT=y
BR2_PACKAGE_S6_BR2_INIT_SERVICES=y
```

## configs/qemu_aarch64_virt_skarnet_glibc_shared_defconfig
```kconfig
BR2_aarch64=y
BR2_TOOLCHAIN_BUILDROOT_GLIBC=y
BR2_PACKAGE_HOST_LINUX_HEADERS_CUSTOM_4_15=y
BR2_INIT_NONE=y
BR2_TARGET_GENERIC_GETTY_PORT="ttyAMA0"
BR2_SYSTEM_DHCP="eth0"
BR2_ROOTFS_OVERLAY="$(BR2_EXTERNAL_SKARNET_PATH)/board/common/overlay $(BR2_EXTERNAL_SKARNET_PATH)/board/qemu/x86/overlay"
BR2_ROOTFS_POST_BUILD_SCRIPT="$(BR2_EXTERNAL_SKARNET_PATH)/board/common/post-build.sh"
BR2_LINUX_KERNEL=y
BR2_LINUX_KERNEL_CUSTOM_VERSION=y
BR2_LINUX_KERNEL_CUSTOM_VERSION_VALUE="4.15.2"
BR2_LINUX_KERNEL_USE_CUSTOM_CONFIG=y
BR2_LINUX_KERNEL_CUSTOM_CONFIG_FILE="board/qemu/aarch64-virt/linux-4.15.config"
BR2_LINUX_KERNEL_NEEDS_HOST_OPENSSL=y
BR2_PACKAGE_BUSYBOX_CONFIG="$(BR2_EXTERNAL_SKARNET_PATH)/board/common/busybox.config"
BR2_PACKAGE_BUSYBOX_WATCHDOG=y
BR2_PACKAGE_DROPBEAR=y
BR2_PACKAGE_NTP=y
BR2_TARGET_ROOTFS_EXT2=y
BR2_TARGET_ROOTFS_EXT2_4=y
# BR2_TARGET_ROOTFS_TAR is not set
BR2_INIT_S6_INIT=y
BR2_PACKAGE_S6_BR2_INIT_SERVICES=y
```

## configs/qemu_arm_versatile_skarnet_uclibc_static_defconfig
```kconfig
BR2_arm=y
BR2_STATIC_LIBS=y
BR2_PACKAGE_HOST_LINUX_HEADERS_CUSTOM_4_13=y
BR2_INIT_NONE=y
BR2_TARGET_GENERIC_GETTY_PORT="ttyAMA0"
BR2_SYSTEM_DHCP="eth0"
BR2_ROOTFS_OVERLAY="$(BR2_EXTERNAL_SKARNET_PATH)/board/common/overlay"
BR2_ROOTFS_POST_BUILD_SCRIPT="$(BR2_EXTERNAL_SKARNET_PATH)/board/common/post-build.sh"
BR2_LINUX_KERNEL=y
BR2_LINUX_KERNEL_CUSTOM_VERSION=y
BR2_LINUX_KERNEL_CUSTOM_VERSION_VALUE="4.13.3"
BR2_LINUX_KERNEL_USE_CUSTOM_CONFIG=y
BR2_LINUX_KERNEL_CUSTOM_CONFIG_FILE="board/qemu/arm-versatile/linux-4.13.config"
BR2_LINUX_KERNEL_DTS_SUPPORT=y
BR2_LINUX_KERNEL_INTREE_DTS_NAME="versatile-pb"
BR2_PACKAGE_BUSYBOX_CONFIG="$(BR2_EXTERNAL_SKARNET_PATH)/board/common/busybox.config"
BR2_PACKAGE_BUSYBOX_WATCHDOG=y
BR2_PACKAGE_DROPBEAR=y
BR2_TARGET_ROOTFS_EXT2=y
# BR2_TARGET_ROOTFS_TAR is not set
BR2_INIT_S6_INIT=y
BR2_PACKAGE_S6_BR2_INIT_SERVICES=y
```

## configs/qemu_x86_64_skarnet_glibc_shared_defconfig
```kconfig
BR2_x86_64=y
BR2_TOOLCHAIN_BUILDROOT_GLIBC=y
BR2_TOOLCHAIN_BUILDROOT_CXX=y
BR2_PACKAGE_HOST_GDB=y
BR2_PACKAGE_HOST_LINUX_HEADERS_CUSTOM_4_15=y
BR2_TARGET_GENERIC_ISSUE="Welcome to S6 demo"
BR2_INIT_NONE=y
BR2_ROOTFS_DEVICE_TABLE="system/device_table.txt $(BR2_EXTERNAL_SKARNET_PATH)/board/common/device_table.txt"
BR2_TARGET_GENERIC_ROOT_PASSWD="root"
BR2_TARGET_GENERIC_GETTY_PORT="tty1"
BR2_SYSTEM_DHCP="eth0"
BR2_ROOTFS_OVERLAY="$(BR2_EXTERNAL_SKARNET_PATH)/board/common/overlay $(BR2_EXTERNAL_SKARNET_PATH)/board/qemu/x86/overlay"
BR2_ROOTFS_POST_BUILD_SCRIPT="$(BR2_EXTERNAL_SKARNET_PATH)/board/common/post-build.sh"
BR2_LINUX_KERNEL=y
BR2_LINUX_KERNEL_CUSTOM_VERSION=y
BR2_LINUX_KERNEL_CUSTOM_VERSION_VALUE="4.15"
BR2_LINUX_KERNEL_USE_CUSTOM_CONFIG=y
BR2_LINUX_KERNEL_CUSTOM_CONFIG_FILE="board/qemu/x86_64/linux-4.15.config"
BR2_PACKAGE_BUSYBOX_CONFIG="$(BR2_EXTERNAL_SKARNET_PATH)/board/common/busybox.config"
BR2_PACKAGE_BUSYBOX_WATCHDOG=y
BR2_PACKAGE_GDB=y
BR2_PACKAGE_STRACE=y
BR2_PACKAGE_DROPBEAR=y
BR2_PACKAGE_NTP=y
BR2_TARGET_ROOTFS_EXT2=y
# BR2_TARGET_ROOTFS_TAR is not set
BR2_INIT_S6_INIT=y
BR2_PACKAGE_S6_BR2_INIT_SERVICES=y
```

## configs/raspberrypi_skarnet_defconfig
```kconfig
BR2_arm=y
BR2_arm1176jzf_s=y
BR2_ARM_EABIHF=y
BR2_STATIC_LIBS=y
BR2_TOOLCHAIN_BUILDROOT_MUSL=y
BR2_PACKAGE_HOST_LINUX_HEADERS_CUSTOM_4_14=y
BR2_TOOLCHAIN_BUILDROOT_CXX=y
BR2_TARGET_GENERIC_ISSUE="Welcome to S6 demo"
BR2_INIT_NONE=y
BR2_ROOTFS_DEVICE_TABLE="system/device_table.txt $(BR2_EXTERNAL)/board/common/device_table.txt"
BR2_TARGET_GENERIC_ROOT_PASSWD="root"
BR2_TARGET_GENERIC_GETTY_PORT="tty1"
BR2_SYSTEM_DHCP="eth0"
BR2_ROOTFS_OVERLAY="$(BR2_EXTERNAL_SKARNET_PATH)/board/common/overlay $(BR2_EXTERNAL_SKARNET_PATH)/board/rpi/overlay"
BR2_ROOTFS_POST_BUILD_SCRIPT="board/raspberrypi/post-build.sh"
BR2_ROOTFS_POST_IMAGE_SCRIPT="board/raspberrypi/post-image.sh"
BR2_LINUX_KERNEL=y
BR2_LINUX_KERNEL_CUSTOM_TARBALL=y
BR2_LINUX_KERNEL_CUSTOM_TARBALL_LOCATION="$(call github,raspberrypi,linux,c117a8bccf37bfba323065b566cf999ed4629a4a)/linux-c117a8bccf37bfba323065b566cf999ed4629a4a.tar.gz"
BR2_LINUX_KERNEL_DEFCONFIG="bcmrpi"
BR2_LINUX_KERNEL_DTS_SUPPORT=y
BR2_LINUX_KERNEL_INTREE_DTS_NAME="bcm2708-rpi-b bcm2708-rpi-b-plus bcm2708-rpi-cm"
BR2_PACKAGE_BUSYBOX_CONFIG="$(BR2_EXTERNAL)/board/common/busybox.config"
BR2_PACKAGE_RPI_FIRMWARE=y
# BR2_PACKAGE_RPI_FIRMWARE_INSTALL_DTB_OVERLAYS is not set
BR2_PACKAGE_DROPBEAR=y
BR2_PACKAGE_NTP=y
BR2_TARGET_ROOTFS_EXT2=y
BR2_TARGET_ROOTFS_EXT2_4=y
# BR2_TARGET_ROOTFS_TAR is not set
BR2_PACKAGE_HOST_DOSFSTOOLS=y
BR2_PACKAGE_HOST_GENIMAGE=y
BR2_PACKAGE_HOST_MTOOLS=y
BR2_INIT_S6_INIT=y
BR2_PACKAGE_S6_BR2_INIT_SERVICES=y
```

## package/Config.in
```kconfig
menu "Target packages"

menu "Hardware handling"
	source "$BR2_EXTERNAL_SKARNET_PATH/package/mdevd/Config.in"
endmenu

menu "System tools"
	source "$BR2_EXTERNAL_SKARNET_PATH/package/s6-br2-init-skeleton/Config.in"
	source "$BR2_EXTERNAL_SKARNET_PATH/package/s6-br2-init-services/Config.in"
endmenu

endmenu
```

## package/Config.in.host
```kconfig
menu "Host utilities"

source "$BR2_EXTERNAL_SKARNET_PATH/package/s6-rc/Config.in.host"

endmenu
```

## system/Config.in
```kconfig
menu "System configuration"

config BR2_INIT_S6_INIT
	bool "Init system based on s6"
	depends on BR2_INIT_NONE
	depends on BR2_ROOTFS_DEVICE_CREATION_DYNAMIC_DEVTMPFS
	depends on BR2_USE_MMU # s6
	select BR2_PACKAGE_S6_BR2_INIT_SKELETON
	help
	  Initialization system based on s6 and friends.

comment "Init system based on s6 requires original init system to be \"None\""
	depends on !BR2_INIT_NONE

comment "/dev management using s6-devd requires devtmpfs only"
	depends on !BR2_ROOTFS_DEVICE_CREATION_DYNAMIC_DEVTMPFS

comment "/dev management using devtmpfs + s6-devd"
	depends on (BR2_INIT_S6_INIT && \
		    BR2_ROOTFS_DEVICE_CREATION_DYNAMIC_DEVTMPFS)

endmenu
```
